## bootloader/u-boot-2022.10/board/realtek_10G_PON/rtl9617d/Kconfig
```kconfig
if TARGET_RTK_RTL9617D

config SYS_SOC
	default "rtl9617d"

config CA8277B
	bool
	default y

config SYS_BOARD
	default "rtl9617d"

config SYS_CONFIG_NAME
	default "rtl9617d"

config SYS_TEXT_BASE
	default "0x04000000"

config IDENT_STRING
	default "RTL9617D-SoC" if ARM64
	default "RTL9617D-SoC-AARCH32" if !ARM64

config BOOTP_VCI_STRING
	default "U-boot.armv8.rtl9617d"
	default "U-boot.armv7.rtl9617d" if !ARM64

endif
```

## linux-5.10.x/Documentation/devicetree/bindings/net/realtek,switchdev.yaml
```yaml
# SPDX-License-Identifier: (GPL-2.0-only OR BSD-2-Clause)
%YAML 1.2
---
$id: http://devicetree.org/schemas/net/realtek,switchdev.yaml#
$schema: http://devicetree.org/meta-schemas/core.yaml#

title: Realtek Switchdev Device Tree Bindings

maintainers:
  - Sam Hsu <sam_hsu@realtek.com>

description: |
  This binding provides support for Realtek switchdev devices.

properties:
  compatible:
    enum:
      - realtek,switchdev

  id:
    maxItems: 1
    description: |
      Physical port index.

  label:
    maxItems: 1
    description: |
      Physical port name.

  mac-address:
    maxItems: 1
    description: |
      MAC address of physical port.

  netdev-name:
    maxItems: 1
    description: |
      netdev name.

required:
  - compatible

additionalProperties: false

examples:
  - |
    switchdev@0 {
		compatible = "realtek,switchdev";
		ethernet-ports {
			rtksw_port0: port@0 {
				id = <0>;
				label = "port0";
				mac-address = [ 00 00 00 00 00 00 ];
				netdev-name = "eth0.2";
			};
			rtksw_port1: port@1 {
				id = <7>;
				label = "port7";
				mac-address = [ 00 00 00 00 00 00 ];
				netdev-name = "nas0";
			};
		};
	};
```

## linux-5.10.x/Documentation/devicetree/bindings/spi/spi-cortina.txt
```
Cortina Access SPI controller

Required properties:
- compatible: Should be "cortina,ca77xx-spi".
- reg: Should contain register location and length.
- interrupts: Should contain interrupt.
- interrupt-parent : Phandle of the parent interrupt controller.
- clocks: The clock feeding the SPI controller.
- #address-cells: number of cells required to define a chip select
- #size-cells: <0>, also as required by generic SPI binding.

Example:
	spi0: spi@f43290e8 {
		compatible = "realtek,rtl_v2-spi", "cortina,ca77xx-spi";
		reg = <0x00000000 0xf43290e8 0x0 0x40>;
		interrupt-parent = <&per_ictl>;
		interrupts = <IRQ_PER_SPI>;
		clocks = <&apb_pclk>;
		#address-cells = <1>;
		#size-cells = <0>;
	};
```

## linux-5.10.x/Documentation/devicetree/bindings/usb/realtek,taurus-usb2.yaml
```yaml
# SPDX-License-Identifier: (GPL-2.0-only OR BSD-2-Clause)
%YAML 1.2
---
$id: http://devicetree.org/schemas/usb/realtek,taurus-usb2.yaml#
$schema: http://devicetree.org/meta-schemas/core.yaml#

title: Realtek SoCs USB2 PHY devicetree bindings

maintainers:
  - darren_wu <darren_wu@realtek.com>

properties:
  compatible:
    items:
      - enum:
          - realtek,taurus-usb2phy # For taurus
          - realtek,elnath-usb2phy # For elnath

  reg:
    items:
      - description: usb2 phy host control register.

  reg-names:
    items:
      - const: u2host_reg

  ranges: true

  resets:
    minItems: 1
    maxItems: 2
    items:
      - description: get usb reset block .
      - description: get usb2 port1 reset block.

  reset-names:
    minItems: 1
    maxItems: 2
    items:
      - const: usbcore_reset
      - const: usb2port1_reset

  portmask:
    description: Enable usb port number

  phy_sel:
    minItems: 1
    maxItems: 2
    items:
      - description: usb2 port0 phy paramselect
      - description: usb2 port1 phy select

  phy_paramN: the number of phy parameter node.
    description: the number of phy parameter node.

  phy_data_verA:
    description: usb2 phy data version string

  phy_data_addrA:
    description: usb2 revA phy address array, it correspond phy_data_arrayA.

  phy_data_arrayA:
    description: usb2 revA phy data array, it correspond phy_data_addrA.

  phy_data_verA_40M:
    description: xtal 40M usb2 phy data version string

  phy_data_addrA_40M:
    description: xtal 40M usb2 revA phy address array, it correspond phy_data_arrayA_40M.

  phy_data_arrayA_40M:
    description: xtal 40M usb2 revA phy data array, it correspond phy_data_addrA_40M.

required:
  - compatible
  - reg
  - reg-names
  - resets
  - reset-names
  - portmask
  - phy_data_verA
  - phy_data_addrA
  - phy_data_arrayA
  - phy_data_verA_40M
  - phy_data_addrA_40M
  - phy_data_arrayA_40M
  - phy_sel

additionalProperties: false

examples:
  - |
    #include <dt-bindings/reset/rtk9607f,rst-mgr.h>
    #include <dt-bindings/phy/phy-rtl8277c.h>

    usb_hsphy: usbphy@f432b020 {
        compatible = "realtek,taurus-usb2phy";
        reg = <0x0 0xf432b020 0x0 0x18>;
        reg-names = "u2host_reg";
        #address-cells = <2>;
        #size-cells = <2>;
        ranges;

        resets = <&block_rst USB_RESET>, <&block_ext_rst USB2_PORT1_RESET>;
        reset-names = "usbcore_reset", "usb2port1_reset";

        portmask = <0x3>;
        phy_data_verA = "revA v1.0 (2020.01.01)";

        phy_sel = <&phy_param0>, <&phy_param0>;
        phy_param0: phy_param0{
            phy_data_addrA = /bits/ 8
                <>;
            phy_data_arrayA = /bits/ 8
                <>;
        };
    };
```

## linux-5.10.x/Documentation/devicetree/bindings/usb/realtek,taurus-usb3.yaml
```yaml
# SPDX-License-Identifier: (GPL-2.0-only OR BSD-2-Clause)
%YAML 1.2
---
$id: http://devicetree.org/schemas/usb/realtek,taurus-usb3.yaml#
$schema: http://devicetree.org/meta-schemas/core.yaml#

title: Realtek SoCs USB3 PHY devicetree bindings

maintainers:
  - Darren Wu <darren_wu@realtek.com>

properties:
  compatible:
    items:
      - enum:
          - realtek,taurus-usb3phy # For taurus
          - realtek,elnath-usb3phy # For elnath

  reg:
    minItems: 4
    items:
      - description: usb3 phy host control register.
      - description: usb3 phy ext host control register.
      - description: usb phy s2 register.
      - description: usb phy s3 register.

  reg-names:
    minItems: 4
    items:
      - const: u3host_reg
      - const: u3ext_reg
      - const: s2usbphy_u3port
      - const: s3usbphy_u3port

  ranges: true

  phys:
    minItems: 2
    description: S2 phy node
    description: S3 phy node

  phy-names:
    minItems: 2
    items:
      - const: s2usb3-phy
      - const: s3usb3-phy

  phymask:
    description: Select which usb port be used 0:S2 1:S3

  phy_data_verA:
    description: usb3 phy data version string

  phy_data_addrA:
    description: usb3 revA phy address array, it correspond phy_data_arrayA.

  phy_data_arrayA:
    description: usb3 revA phy data array, it correspond phy_data_addrA.

  phy_data_verA_40M:
    description: xtal 40M usb3 phy data version string

  phy_data_addrA_40M:
    description: xtal 40M usb3 revA phy address array, it correspond phy_data_arrayA_40M.

  phy_data_arrayA_40M:
    description: xtal 40M usb3 revA phy data array, it correspond phy_data_addrA_40M.

  s2_usb_phy:
    description: specifies usb2 phy node.

required:
  - compatible
  - reg
  - reg-names
  - phys
  - phy-names
  - phymask
  - phy_data_verA
  - phy_data_addrA
  - phy_data_arrayA
  - phy_data_verA_40M
  - phy_data_addrA_40M
  - phy_data_arrayA_40M
  - usb2-phy

additionalProperties: false

examples:
  - |
    #include <dt-bindings/phy/phy-rtl8277c.h>

    usb_ssphy: usbphy@f432b000 {
        compatible = "realtek,elnath-usb3phy";
        reg = <0x0 0xf432b000 0x0 0x20>,
            <0 0xf432b04c 0x0 0x10>,
            <0 0xf4337000 0x0 0x1000>,
            <0 0xf4338000 0x0 0x1000>;
        reg-names = "u3host_reg", "u3ext_reg", "s2usbphy_u3port", "s3usbphy_u3port";
        #address-cells = <2>;
        #size-cells = <2>;
        ranges;

        phys = <&s2_usb_phy>, <&s3_usb_phy>;
        phy-names = "s2usb3-phy", "s3usb3-phy";

        phymask = <0x2>;
        phy_data_verA = "revA v1.0 (2020.01.01)";
        phy_data_addrA = /bits/ 8
             <>;
        phy_data_arrayA = /bits/ 16
             <>;

        phy_data_verA_40M = "revA v1.0 (2020.01.01)";
        phy_data_addrA_40M = /bits/ 8
             <;
        phy_data_arrayA_40M = /bits/ 16
             <>;
        usb2-phy = <&usb_hsphy>;
    };
```

## linux-5.10.x/arch/arm/mach-realtek/Kconfig
```kconfig
if ARCH_CORTINA_VENUS || ARCH_REALTEK_TAURUS || ARCH_REALTEK_9607F

menu "RTK Platform selection"
choice
        prompt "Board Type"
        default CORTINA_BOARD_VENUS_ENG
        help
          Choose the board type

	config REALTEK_BOARD_9607F_ENG
        bool "9607F Engineering Board"
        help
          Realtek ELNATH Engineering Board

	config REALTEK_BOARD_TAURUS_ENG
        bool "Taurus Engineering Board"
        help
          Realtek Taurus Engineering Board

	config CORTINA_BOARD_VENUS_ENG
        bool "Venus Engineering Board"
        help
          Cortina Venus Engineering Board

endchoice

	config RTK_DEV_AP
	bool "Realtek Device type Wifi AP"
	default n
	help
	  This product is designed for Wifi AP.

	config RTK_DEV_APROUTER_ONLY
	bool "AP-Router only"
	default n
	help
	  AP-Router Only.

choice
        prompt "CA PON MODE"
        default CORTINA_PON_MODE_DUAL
        depends on ARCH_CORTINA

config CORTINA_PON_MODE_DUAL
        bool "DUAL MODE"
        help
          Cortina PON DUAL MODE

config CORTINA_PON_MODE_GPON
        bool "GPON MODE"
        help
          Cortina GPON MODE

config CORTINA_PON_MODE_EPON
        bool "EPON MODE"
        help
          Cortina EPON DUAL MODE
endchoice

source "arch/arm/mach-realtek/Kconfig.hook"
endmenu
endif
```
