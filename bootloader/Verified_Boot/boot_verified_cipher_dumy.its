## linux-5.10.x/realtek/Kconfig
```kconfig
menu "Realtek Modules"
config RTK_USE_ONE_UBI_DEVICE
    bool "RTK use single UBI device"
	depends on MTD_UBI && UBIFS_FS
	help
		Use single UBI device to contain DTB/kernel/rootfs/....

config RTK_HOST_SPEEDUP
	bool "TCP: Host SPEEDUP support"
	help
		Support for local in/out network traffic which does not pass through netfilter.

		The speedtest module for TR143/iperf is a software tool that measures the performance
		and quality of a network connection. It uses the TR-143 protocol and the iperf application
		to conduct network throughput tests.

config RTK_NETLOG
    bool "NetLogger"
   	depends on SERIAL_8250=y
	default n if !ARCH_LUNA_SLAVE

config  RTK_KERNEL_OMD
    bool "Support RTK Kernel OMD Func"
	depends on YUEME

config RTK_HS_UART
    bool "Support RTK high speed UART"

config RTK_VBUS_CHAIN
    bool "USB VBus Chain"
       depends on USB && RESET_CONTROLLER
       help
        Select Y if board has VBUS controller IC

config  RTK_ARM64_WATCHPOINT_DEBUG
    bool "Provide ARM64 WATCHPONT Debug Func"
	depends on ARM64

config RTK_GENERIC_NETLINK_API
    bool "RTK Generic netlink method API"
        default n
        help
            Using Generic Netlink to Communicate with Userspace

config RTK_IPV6_ETHERNET_TUNNEL
	tristate "IPv6: Ethernet-in-IPv6 tunnel"
	depends on IPV6_TUNNEL
	default n
	help
		Support for Ethernet-in-IPv6 tunnel.

menuconfig RTK_PE
	bool "Packet Engine"
	select REALTEK_IPC2RCPU
	select CORTINA_PELOG
	select OFFLOAD1_PE1_SUPPORT
	select RESET_TAURUS_PE if ARCH_REALTEK_TAURUS
	select RESET_ELNATH_PE if ARCH_REALTEK_9607F
	default n

config RTK_REMOTE_ADSL
    tristate "Support Realtek Remote ATM module"
choice
	prompt "RTK_ATM Mode"
	default REMOTE_ADSL_HOST
	depends on RTK_REMOTE_ADSL
config REMOTE_ADSL_HOST
    bool "Host"
config REMOTE_ADSL_PHY
    bool "PHY"
endchoice
config REMOTE_ADSL_DEV
    string "REMOTE_DEV"
    default "eth0.2"
    depends on RTK_REMOTE_ADSL

config RTK_MIRROR
	bool "mirror support in protocol stack"

config KERNEL_SUPPORT_FPGA_2P5G
    bool "MiniOLT symmetrical 2.5g FPGA platform"
        default n
        help
            should be turned on with CONFIG_USER_SUPPORT_FPGA_2P5G opened in user	


source "realtek/framework_protector/Kconfig"

endmenu
```

## linux-5.10.x/sound/soc/realtek/Kconfig
```kconfig
#
config SND_RTL8277C_SOC_I2S
	tristate "SoC Audio for the Realtek rtl8277c chips"
	help
	  Say Y if you want to add support for codecs attached to
	  the RTL8277c I2S interfaces.
config SND_RTL8277C_SOC_IIS_TEST
	depends on SND_RTL8277C_SOC_I2S
	tristate  "SoC I2S Audio support for RTL8277c - to - dummy (self-test used)"

config SND_RTL8277X_SOC_SSP
	tristate "SoC Audio for the Realtek Systems RTL8277x chip"
	depends on ARCH_CORTINA
	help
	  Say Y or M if you want to add support for codecs attached to
	  the CA77XX PCM or I2S interface. You will also need
	  to select the audio interfaces to support below.

config SND_RTL8277X_SOC_SSP_DIAG
	tristate "SoC Audio Diagnostic for the Realtek Systems RTL8277x chip"
	depends on SND_RTL8277X_SOC_SSP
	help
	  Say M if you want to add diagnostic for the RTL8277x PCM or I2S
	  interface.

config SND_RTL8277X_SOC_SSP_PINCRTL
	tristate "SoC Audio Diagnostic for the Realtek Systems RTL8277x chip PIN CTRL"
	depends on SND_RTL8277X_SOC_SSP
	help
	  Say M if you want to add pinctrl for the RTL8277x PCM or I2S
	  interface.
```

## tools/uboot_fit_image_2DTBS.its
```
/dts-v1/;
/ {
    description = "fitImage for RTK aarch64 kernel";
    #address-cells = <0x1>;
    images {
        kernel@0 {
            description = "Linux Kernel";
            data = /incbin/("./Image.lzma");
            type = "kernel";
            arch = "arm64";
            os = "linux";
            compression = "lzma";
            load = <0x80000>;
            entry = <0x80000>;
        };
        fdt@0 {
              description = "Flattened Device Tree blob";
              data = /incbin/("rtl8277C-engboard.dtb.lzma");
              type = "flat_dt";
              load = <0x01800000>;
              arch = "arm64";
              compression = "lzma";
        };
        fdt@1 {
              description = "Flattened Device Tree blob";
              data = /incbin/("ca8277B-engboard.dtb.lzma");
              type = "flat_dt";
              load = <0x01800000>;
              arch = "arm64";
              compression = "lzma";
        };
    };
    configurations {
        default = "conf@0";
        conf@0 {
            description = "Boot Linux kernel with FDT blob ";
            kernel = "kernel@0";
            fdt = "fdt@0";
			compatible = "realtek,taurus";
        };
        conf@1 {
            description = "Boot Linux kernel with FDT blob ";
            kernel = "kernel@0";
            fdt = "fdt@1";
			compatible = "cortina,venus";
        };
    };
};
```

## tools/uboot_fit_image_2DTBS_taurus_elnath.its
```
/dts-v1/;
/ {
    description = "fitImage for RTK aarch64 kernel";
    #address-cells = <0x1>;
    images {
        kernel@0 {
            description = "Linux Kernel";
            data = /incbin/("./Image.lzma");
            type = "kernel";
            arch = "arm64";
            os = "linux";
            compression = "lzma";
            load = <0x0>;
            entry = <0x0>;
        };
        fdt@0 {
              description = "Flattened Device Tree blob";
              data = /incbin/("rtl8277C-engboard.dtb.lzma");
              type = "flat_dt";
              load = <0x01800000>;
              arch = "arm64";
              compression = "lzma";
        };
        fdt@1 {
              description = "Flattened Device Tree blob";
              data = /incbin/("rtl9607F-engboard.dtb.lzma");
              type = "flat_dt";
              load = <0x01800000>;
              arch = "arm64";
              compression = "lzma";
        };
    };
    configurations {
        default = "conf@0";
        conf@0 {
            description = "Boot Linux kernel with FDT blob (taurus)";
            kernel = "kernel@0";
            fdt = "fdt@0";
			compatible = "realtek,taurus";
        };
        conf@1 {
            description = "Boot Linux kernel with FDT blob (elnath)";
            kernel = "kernel@0";
            fdt = "fdt@1";
			compatible = "realtek,9607f";
        };
    };
};
```

## tools/uboot_fit_image_A32_singleDTB.its
```
/dts-v1/;
/ {
	description = "fitImage for RTK arm kernel";
	#address-cells = <0x1>;
	images {
		description = "One kernel and dtb";
		kernel {
			description = "Linux Kernel";
			data = /incbin/("zImage");
			type = "kernel";
			arch = "arm";
			os = "linux";
			compression = "none";
			load = <0x80000>;
			entry = <0x80000>;
		};
		fdt-1 {
			  description = "Flattened Device Tree blob";
			  data = /incbin/("board_raw.dtb");
			  type = "flat_dt";
			  load = <0x01800000>;
			  arch = "arm";
			  compression = "none";
		};
	};

    configurations {
        default = "conf-1";
        conf-1 {
            description = "Boot Linux kernel with FDT blob";
            kernel = "kernel";
            fdt = "fdt-1";
        };
    };

};
```

## tools/uboot_fit_signature_image_A64_1DTB.its
```
/dts-v1/;
/ {
    description = "fitImage for RTK aarch64 kernel";
    #address-cells = <0x1>;
    images {
        kernel@0 {
            description = "Linux Kernel";
            data = /incbin/("./Image.lzma");
            type = "kernel";
            arch = "arm64";
            os = "linux";
            compression = "lzma";
            load = <0x80000>;
            entry = <0x80000>;
            hash@1 {
                algo = "sha256";
            };
            signature@1 {
                algo = "sha256,rsa2048";
                key-name-hint = "dev";
            };
        };
        fdt@0 {
              description = "Flattened Device Tree blob";
              data = /incbin/("./board_raw.dtb");
              type = "flat_dt";
              load = <0x01800000>;
              arch = "arm64";
              compression = "none";
              hash@1 {
                algo = "sha256";
              };
                signature@1{
                    algo = "sha256,rsa2048";
                    key-name-hint = "dev";
                };
        };
        script@0 {
            description = "Script";
            data = /incbin/("./uboot_verity_script");
            type = "script";
            compression = "none";
            hash@0 {
                algo = "sha256";
            };
            signature@0 {
                algo = "sha256,rsa2048";
                key-name-hint = "dev";
            };
        };
    };
    configurations {
        default = "conf@1";
        conf@1 {
            description = "Boot Linux kernel with FDT blob ";
            kernel = "kernel@0";
            fdt = "fdt@0";
            script = "script@0";
            hash@1 {
                algo = "sha256";
            };
            signature@1 {
                algo = "sha256,rsa2048";
                key-name-hint = "dev";
                sign-images = "fdt", "kernel", "script";
            };
        };
    };
};
```
