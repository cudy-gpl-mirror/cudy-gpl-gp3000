## bootloader/Verified_Boot/boot_verified_cipher_dumy.its
```
/dts-v1/;
/ {
    description = "fitImage for RTK aarch64 kernel";
    #address-cells = <0x1>;
    images {
        kernel {
            description = "Linux Kernel";
            data = /incbin/("./tmp/dumy1");
            type = "kernel";
            arch = "arm64";
            os = "linux";
            compression = "lzma";
            load = <0x80000>;
            entry = <0x80000>;
            hash {
                algo = "sha256";
            };
            signature {
                algo = "sha256,rsa2048";
                key-name-hint = "dev";
                padding ="pss";
            };
            cipher {
                    algo = "aes256";
                    key-name-hint = "DATA_KEY";
                    iv-name-hint = "DATA_IV";
            };
        };
        fdt {
              description = "Flattened Device Tree blob";
              data = /incbin/("./tmp/dumy0");
              type = "flat_dt";
              load = <0x01000000>;
              arch = "arm64";
              compression = "none";
              hash {
                algo = "sha256";
              };
              signature {
                algo = "sha256,rsa2048";
                key-name-hint = "dev";
                padding ="pss";
              };
              cipher {
                 algo = "aes256";
                 key-name-hint = "DATA_KEY";
                 iv-name-hint = "DATA_IV";
              };
        };
    };
    configurations {
        default = "conf";
        conf {
            description = "Boot Linux kernel with FDT blob ";
            kernel = "kernel";
            fdt = "fdt";
            hash {
                algo = "sha256";
            };
            signature {
                algo = "sha256,rsa2048";
                key-name-hint = "dev";
                padding ="pss";
                sign-images = "fdt", "kernel";
            };
        };
    };
};
```

## bootloader/Verified_Boot/boot_verified_dumy.its
```
/dts-v1/;
/ {
    description = "fitImage for RTK aarch64 kernel";
    #address-cells = <0x1>;
    images {
        kernel {
            description = "Linux Kernel";
            data = /incbin/("./tmp/dumy1");
            type = "kernel";
            arch = "arm64";
            os = "linux";
            compression = "lzma";
            load = <0x80000>;
            entry = <0x80000>;
            hash {
                algo = "sha256";
            };
            signature {
                algo = "sha256,rsa2048";
                key-name-hint = "dev";
            };
        };
        fdt {
              description = "Flattened Device Tree blob";
              data = /incbin/("./tmp/dumy0");
              type = "flat_dt";
              load = <0x01000000>;
              arch = "arm64";
              compression = "none";
              hash {
                algo = "sha256";
              };
                signature {
                    algo = "sha256,rsa2048";
                    key-name-hint = "dev";
                };
        };
    };
    configurations {
        default = "conf";
        conf {
            description = "Boot Linux kernel with FDT blob ";
            kernel = "kernel";
            fdt = "fdt";
            hash {
                algo = "sha256";
            };
		signature {
			algo = "sha256,rsa2048";
			key-name-hint = "dev";
			sign-images = "fdt", "kernel";
		};
        };
    };
};
```

## bootloader/u-boot-2022.10/board/realtek_10G_PON/Kconfig
```kconfig
source "board/realtek_10G_PON/common/Kconfig"
if TARGET_VENUS
source "board/realtek_10G_PON/venus/Kconfig"
endif

if TARGET_RTK_TAURUS
source "board/realtek_10G_PON/taurus/Kconfig"
endif

if TARGET_RTK_ELNATH
source "board/realtek_10G_PON/elnath/Kconfig"
endif

if TARGET_RTK_MERCURY
source "board/realtek_10G_PON/mercury/Kconfig"
endif

if TARGET_RTK_RTL9617D
source "board/realtek_10G_PON/rtl9617d/Kconfig"
endif
```

## bootloader/u-boot-2022.10/board/realtek_10G_PON/common/Kconfig
```kconfig
config SYS_VENDOR
	default "realtek_10G_PON"

config NR_DRAM_BANKS
	default 3

config DISPLAY_BOARDINFO
	default n

config CMD_LOADB
	default y

config CMD_SAVEENV
	default y

config BOOTDELAY
	default 3

config CMDLINE_EDITING
	default y

config CORTINA_UART
	bool
	default y

config RTK_RAMFS
    tristate "RAMFS u-boot only Used on FPGA"
    help
       Map RAMFS on FPGA, which is only used for verificaion

config RTK_SPI_FLASH_IO_BITS
	int "Serial MAND/NOR Flash read/write IO bits"
	default 1
	help
		SIO=1, DIO/X2=2, QIO/X4=4

config MTD_CORTINA_SERIAL_NOR
	tristate "Serial NOR Flash device mapped on Cortina SoC Platforms"
	help
		Map driver for CORTINA reference board.

config CORTINA_SERIAL_NAND
	tristate "Serial NAND Flash device mapped on Cortina SoC Platforms"
	help
		Map driver for CORTINA reference board.

config CORTINA_SPINAND_BBT
	bool "MTD: SPINAND Bad Block Table(For linux-4.4)"
	depends on CORTINA_SERIAL_NAND
	default y if !TARGET_RTK_ELNATH
	help
		MTD NAND Bad Block Table

config CORTINA_PNAND
	tristate "NAND Flash device on Cortina-Access board"
	help
		This enables the driver for the Cortina board to access the nand device.

config CORTINA_PNAND_ECC_LEVEL
	int "Cortina-Access Nand driver HW ecc level"
	default 3
	range 0 5
	depends on CORTINA_PNAND
	help
		NAND Flash ECC algorithm. Value range is from 0 to 5. The default value is 3.

		0: Hamming algorithm. Correct 3 bad bits in 256 btyes.
		1: Hamming algorithm. Correct 3 bad bits in 512 btyes.
		2: BCH algorithm. Correct 8 bad bits in 512 btyes.
		3: BCH algorithm. Correct 16 bad bits in 512 btyes.
		4: BCH algorithm. Correct 24 bad bits in 512 btyes.
		5: BCH algorithm. Correct 40 bad bits in 512 btyes.

config CORTINA_PNAND_ECC_HW_BCH
     bool
     default y
     depends on CORTINA_PNAND_ECC_LEVEL=2 \
             || CORTINA_PNAND_ECC_LEVEL=3 \
             || CORTINA_PNAND_ECC_LEVEL=4 \
             || CORTINA_PNAND_ECC_LEVEL=5

config NAND_HIDE_BAD
    bool "Hide NAND flash factory bad block"
    help
        Bad block are hidden and flash space is remapped as a continue good space.

config CONS_INDEX_0
	bool
	default y

config UART_CLOCK
	int

config NI_PHY_ADDR_GMAC0
	int
	default 1

config NI_PHY_ADDR_GMAC1
	int
	default 2

config NI_PHY_ADDR_GMAC2
	int
	default 3


config G3_NAND_ECC_HW_BCH_LEVEL
	int

config G3_NAND_HWECC
	bool

config NAND_G3
	bool

menuconfig REALTEK_10G_PON
	bool "RealTek Luna support"

if REALTEK_10G_PON
config RTK_V7_FPGA_PLATFORM
	bool "Venus/Taurus/Elnath V7 FPGA BOARD"
	default n
	 help
	 For Venus/Trurus/Elnath V7 FPGA Development.

config RTK_V8_FPGA_PLATFORM
	bool "Elnath/Mercury V8 FPGA BOARD"
	default n
	help
	For Elnath/Mercury V8 FPGA Development.

config RTK_MERCURY_SINGLE_FPGA_PLATFORM
    bool "Mercury V8 Single FPGA BOARD"
    default n
    help
    For Mercury V8 Single FPGA Development.

config RTK_ZEBU_SIM
	bool "Elnath ZEBU simulation"
	default n
	help
        For Elnath ZEBU simulation use

config RTK_USE_ONE_UBI_DEVICE
	bool "RTK use single UBI device"
	depends on CMD_UBI
	help
		Use single UBI device for config/DTB/kernel/rootfs/...

config LUNA_MULTI_BOOT
	bool "LUNA MULTI BOOT"
	default n
	help
		Luna multi-boot
config RTK_LED_STYLE_GPIO
	bool "RTK LED System Use GPIO"
	default n
	help
	RTK Demo Board use GPIO to control LED.

config ENV_CALLBACK_LIST_STATIC
	string
	default "pwr_led_flash:pwr_led_flash,pwr_led_gpio:pwr_led_gpio"
	depends on RTK_LED_STYLE_GPIO
	help
	Env variable "pwr_led_flash" can influence PWR LED behavior
	pwr_led_flash : 1 , Always on
	pwr_led_flash : 300 . Every 300ms , switch once.

config RTK_PWR_BOOT_ON
	bool "RTK LED System: PWR_LED ON on booting "
	depends on  RTK_LED_STYLE_GPIO
	help
	PWR_LED always on when uboot bring up.

config EARLY_PWR_LED_INIT
	bool "RTK LED System: Initialize power led before env setup"
	default n
	depends on  RTK_LED_STYLE_GPIO
	help
	Enable EARLY_PWR_LED_INIT to use default LED_PWR_G_GPIO defined in rtk_gpio_led.c,
	and blink the LED before env setup.

	Say Y here only if LED_PWR_G_GPIO has been modified to meet the board design since
	it's unable to get the gpio saved in env.

config MULTICAST_UPGRADE
	bool "RTK Luna MULTICAST_UPGRADE"
	select LUNA_MULTI_BOOT
	help
		Multicast upgrade firmware.

config MULITCASTUPGRADE_BIND_RESETBUTTON
    bool "muticast upgrade bind reset button"
    default n
    depends on MULTICAST_UPGRADE
    help
        muticast upgrade bind reset button
        
config CMD_OTP
    bool "Secure OTP access command"
    default n
    help
        OTP content access through SMC call.

config CMD_CRYPTO
    bool "Secure Encryption/Decryption command"
    default n
    help
        Secure Encryption/Decryption command.
        
config CMD_SPI_NAND_TEST_FUNC
    bool "Enable SPI NAND flash test function"
    default n
    help
        Enable the SPI NAND relative test command for in-house verification. 


config CMD_SPI_NOR_TEST_FUNC
    bool "Enable SPI NOR flash test function"
    default n
    help
        Enable the SPI NOR relative test command for in-house verification.       

config CMD_DRAM_TEST_FUNC
        bool "Enable DRAM memory test function"
        default n
        help
          Enable dram memory test function command.

config TARGET_RTK_VENUS_FT
        bool "RTK VENUS FT BOARD"
        default n
        help
                For RTK VENUS FT Development.

config TARGET_RTK_MERCURY_FT
        bool "RTK MERCURY FT BOARD"
        default n
        help
                For RTK MERCURY FT Development.

config BL_IMAGE_INC_OPTEED
        bool "RTK BL image contains OPTEE(Bl32) Image"
        default n
        help
                Bootloader image contains OPTEE(Bl32) image for TEE

config RTK_SOC_EXP_FLASH_LAYOUT
	bool "RTK Soc Experiment Loader Layout"
	default n
	help
	 It will change NAND_BBL_OFFSET  because layout is large than product.
	 If not sure, say N here.

config CMD_SOC_TEST
        bool "support CN2/3 SOC cmd test"
        default n
        help
          utilities and options you want.

config RTK_ENG_CMD
        bool "Support engineer mode command"
        default n
        help
          Private engineer mode command.

config RTK_PE_CLK_CMD
        bool "Support PE CLK change cmd"
        depends on TARGET_RTK_ELNATH
        default n
        help
          Say no, if you not sure.

config CMD_RTK_LDMA_TEST
        bool "support RTK LDMA cmd test"
        depends on CMD_SOC_TEST
        help
          realtek LDMA test cmd

config CMD_RTK_XRAM_TEST
        bool "support RTK XRAM cmd test"
        depends on CMD_SOC_TEST
        help
          realtek XRAM test cmd

config CMD_RTK_I2S
        bool "support RTK I2S cmd test"
        depends on CMD_SOC_TEST
        help
          realtek i2s test cmd

config CMD_RTK_SPI
        bool "support DW SSI test"
        depends on CMD_SOC_TEST
        help
          BJ4

config CMD_RTK_GDMA
        bool "support DW GDMA test"
        depends on CMD_SOC_TEST
        help
          BJ4

config CMD_CA_RTC
        bool "support CA RTC(Real Time Clock)"
        depends on CMD_SOC_TEST
        help
          BJ4

config CMD_RTK_CRYPTO
        bool "support RTK CRYPTO cmd test"
        depends on CMD_SOC_TEST
        help
          realtek crypto test cmd

config CMD_RTK_CRYPTO_V3_EXTENSION
        bool "support RTK CRYPTO V3 Extend"
        depends on CMD_SOC_TEST && CMD_RTK_CRYPTO
        help
          realtek crypto v3 extend

config CMD_RTK_UART
        bool "support RTK UART_DMA cmd test"
        depends on CMD_SOC_TEST
        help
          realtek UART_DMA test cmd

config CMD_RTK_SD30
        bool "support RTK SD30 cmd test"
        depends on CMD_SOC_TEST
        help
          BJ4

config CMD_RTK_EMMC
        bool "support RTK EMMC cmd test"
        depends on CMD_SOC_TEST
        help
          BJ4

config CMD_RTK_PER_TMR_TEST
        bool "support RTK PER_TMR/PER_SYS_TMR cmd test"
        depends on CMD_SOC_TEST
        help
          realtek PER_TMR/PER_SYS_TMR test cmd

config RTK_MULTI_CPU_CMD
	bool "support multi cpu command"
        depends on CMD_SOC_TEST
	default n
	 help
          Say yes here to support slave cpu command.


config RTK_L3_PART_PWR_CMD
	bool "support L3 partial PowerDown(Experiment)"
        depends on CMD_SOC_TEST
	default n
	 help
          Say no, if not sure.

config RTK_TINYMEMBENCH
	bool "support tinymembench latency(Experiment)"
        depends on CMD_SOC_TEST
	default n
	 help
          Say no, if not sure.

config RTK_GPIO
        bool "support RTK GPIO driver"
        depends on DM_GPIO
        default n
        help
          Say yes here to support realtek GPIO driver.
config REALTEK_KASLR
        bool "support RTK KASLR SEED"
        default n
        select LIB_RAND
        help
          Say yes here to set randomization Linux kaslr-seed.

config RTK_OPTEE_VERIFIED_BOOT
        bool "Support u-boot verified boot via OPTEE"
        depends on OPTEE && FIT_SIGNATURE
        default n
        help
          Say yes here to support verified boot via OPTEE.

config RTK_NI_SUPPORT_RTL8221B
	bool "support RTL8221B"
	depends on (RTK_NI_SUPPORT_HSGMII_P4 || RTK_NI_SUPPORT_HSGMII_P5 || RTK_NI_SUPPORT_HSGMII_P6 || RTK_NE_SUPPORT_HSGMII_P7)
	default n
	 help
          Say yes here to support realtek RTL8221B driver.

config RTK_NI_SUPPORT_RTL8224B
	bool "support RTL8224B"
	depends on RTK_NI_SUPPORT_QXGMII_P6
	default n
	 help
          Say yes here to support realtek RTL8224B driver.

config RTK_NI_SUPPORT_RTL8261I
	bool "support RTL8261I"
	depends on (RTK_NI_SUPPORT_USXGMII_P6 || RTK_NI_SUPPORT_HSGMII_P4)
	default n
	 help
          Say yes here to support realtek RTL8261I driver.

config RTK_NI_SERDES
	bool "support RTK serdes driver"
	default n
	 help
          Say yes here to support realtek serdes driver.

config RTK_NI_SUPPORT_HSGMII_P4
	bool "support HSGMII port 4"
	depends on RTK_NI_SERDES
	default n
	 help
          Say yes here to support realtek port 4 HSGMII driver.

config RTK_NI_SUPPORT_HSGMII_P5
	bool "support HSGMII port 5"
	depends on RTK_NI_SERDES
	default n
	 help
          Say yes here to support realtek port 5 HSGMII driver.

config RTK_NI_SUPPORT_RXAUI_P5
	bool "support RXAUI port 5"
	depends on RTK_NI_SERDES
	default n
	 help
          Say yes here to support realtek port 5 RXAUI driver.

config RTK_NI_SUPPORT_HSGMII_P6
	bool "support HSGMII port 6"
	depends on RTK_NI_SERDES
	default n
	 help
          Say yes here to support realtek port 6 HSGMII driver.

config RTK_NI_SUPPORT_QXGMII_P6
	bool "support QXGMII port 6"
	depends on RTK_NI_SERDES
	default n
	 help
          Say yes here to support realtek port 6 QXGMII driver.

config RTK_NI_SUPPORT_USXGMII_P6
	bool "support USXGMII port 6"
	depends on RTK_NI_SERDES
	default n
	 help
          Say yes here to support realtek port 6 USXGMII driver.

config RTK_NI_SUPPORT_XFI_P6
        bool "support XFI port 6"
        depends on RTK_NI_SERDES
        default n
         help
          Say yes here to support realtek port 6 XFI driver.

config RTK_NE
	bool "support RTK NE"
	default n
	 help
          Say yes here to support realtek NE driver.

config RTK_NE_SUPPORT_HSGMII_P7
	bool "support HSGMII port 7"
	depends on RTK_NE
	default n
	 help
          Say yes here to support realtek port 7 HSGMII driver.

endif
```

## bootloader/u-boot-2022.10/board/realtek_10G_PON/mercury/Kconfig
```kconfig
if TARGET_RTK_MERCURY

config BIT64

config SYS_SOC
	default "mercury"

config CA8277B
	bool
	default y

config SYS_BOARD
	default "mercury"

config SYS_CONFIG_NAME
	default "mercury"

config SYS_TEXT_BASE
	default "0x04000000"

config SYS_INIT_SP_ADDR
    hex
    default 0x00100000

config SYS_MEMTEST_SCRATCH
    hex
    default 0x00100000

config IDENT_STRING
	default "MERCURY-SoC" if ARM64
	default "MERCURY-SoC-AARCH32" if !ARM64

config BOOTP_VCI_STRING
	default "U-boot.armv8.mercury"
	default "U-boot.armv7.mercury" if !ARM64

endif
```
