## linux-5.10.x/arch/arm64/Kconfig.platforms
```kconfig
# SPDX-License-Identifier: GPL-2.0-only
menu "Platform selection"

config ARCH_CORTINA
	bool "Cortina Access platform"
	help
	  This enables support for Cortina Access SoCs.

config ARCH_CORTINA_SMC
	bool "SMC for Cortina AARCH64"
	depends on ARCH_CORTINA && ARM64
	help
	  This enables support for Cortina private SMC call for secured register access.

config ARCH_CORTINA_GIC_V3_BOTH
	bool "Support both ARM_GIC_V3 and ARM_GIC_V3_SECURED"
	depends on ARCH_CORTINA && ARM64
	select ARM_GIC_V3_SECURED
	select ARM_GIC_V3
	help
	  This enables support Native ARM GIC_V3 and CA ARM_GIC_V3_SECURED Driver

choice
	prompt "Cortina Arch Type"
	default ARCH_CORTINA_NONE
	help
	  Choose the G3 arch type

config ARCH_CORTINA_NONE
	bool "None"
	help
	  This is not Cortina Arch.

config ARCH_CORTINA_VENUS
	bool "Venus"
	select GENERIC_IRQ_CHIP
	select PINCTRL
	select PINCTRL_CORTINA
	select VENUS_DRIVER_SUPPORT
	help
	  This is Cortina Access Venus SoC.

endchoice

config ARCH_REALTEK_TAURUS
        bool "Realtek Arch64 Platforms (Taurus)"
        select GENERIC_IRQ_CHIP
        select PINCTRL
        select PINCTRL_CORTINA
        help
          This is Realtek TAURUS SoC.

config ARCH_REALTEK_9607F
        bool "Realtek Arch64 Platforms (Elnath)"
        select GENERIC_IRQ_CHIP
        select PINCTRL
        select PINCTRL_CORTINA
        help
          This is Realtek 9607F SoC.

config CA_NIC_PHYDEV_SUPPORT
	bool "Phydev Support"
	default n
	depends on ARCH_REALTEK_9607F || ARCH_REALTEK_TAURUS
	help
	  Enable phydev support for internal phy.


config RTK_DEV_AP
	bool "Realtek Device type Wifi AP"
	help
	  This product is designed for Wifi AP.

config RTK_DEV_APROUTER_ONLY
	bool "AP-Router only"
	default n
	help
          AP-Router Only

choice
	prompt "Board Type"
	default CORTINA_BOARD_FPGA
	help
	  Choose the board type

config CORTINA_BOARD_FPGA
	bool "FPGA Board"
	help
	  Cortina FPGA Board

config REALTEK_BOARD_FPGA
	bool "Realtek FPGA Board"
	help
	  Realtek FPGA Board

config REALTEK_BOARD_FPGA_V8
	bool "Realtek FPGA V8 Board"
	help
	  Realtek FPGAv8 Board

config REALTEK_BOARD_TAURUS_ENG
	bool "Taurus Engineering Board"
	help
	  Realtek Taurus Engineering Board

config REALTEK_BOARD_9607F_ENG
	bool "9607F Engineering Board"
	help
	  Realtek 9607F Engineering Board
config CORTINA_BOARD_VENUS_ENG
	bool "Venus Engineering Board"
	help
	  Cortina Venus Engineering Board

config CORTINA_BOARD_G3_ENG
	bool "G3 Engineering Board"
	help
	  Cortina Engineering Board

config CORTINA_BOARD_G3HGU_ENG
	bool "G3HGU Engineering Board"
	help
	  Cortina Engineering Board
endchoice

choice
	prompt "CA PON MODE"
	default CORTINA_PON_MODE_DUAL
	depends on ARCH_CORTINA

config CORTINA_PON_MODE_DUAL
	bool "DUAL MODE"
	help
	  Cortina PON DUAL MODE 

config CORTINA_PON_MODE_GPON
	bool "GPON MODE"
	help
	  Cortina GPON MODE 

config CORTINA_PON_MODE_EPON
	bool "EPON MODE"
	help
	  Cortina EPON DUAL MODE 

endchoice

source "arch/arm64/Kconfig.hook"

config ARCH_ACTIONS
	bool "Actions Semi Platforms"
	select OWL_TIMER
	select PINCTRL
	help
	  This enables support for the Actions Semiconductor S900 SoC family.

config ARCH_AGILEX
	bool "Intel's Agilex SoCFPGA Family"
	help
	  This enables support for Intel's Agilex SoCFPGA Family.

config ARCH_SUNXI
	bool "Allwinner sunxi 64-bit SoC Family"
	select ARCH_HAS_RESET_CONTROLLER
	select GENERIC_IRQ_CHIP
	select PINCTRL
	select RESET_CONTROLLER
	help
	  This enables support for Allwinner sunxi based SoCs like the A64.

config ARCH_ALPINE
	bool "Annapurna Labs Alpine platform"
	select ALPINE_MSI if PCI
	help
	  This enables support for the Annapurna Labs Alpine
	  Soc family.

config ARCH_BCM2835
	bool "Broadcom BCM2835 family"
	select TIMER_OF
	select GPIOLIB
	select MFD_CORE
	select PINCTRL
	select PINCTRL_BCM2835
	select ARM_AMBA
	select ARM_GIC
	select ARM_TIMER_SP804
	help
	  This enables support for the Broadcom BCM2837 and BCM2711 SoC.
	  These SoCs are used in the Raspberry Pi 3 and 4 devices.

config ARCH_BCM_IPROC
	bool "Broadcom iProc SoC Family"
	select COMMON_CLK_IPROC
	select GPIOLIB
	select PINCTRL
	help
	  This enables support for Broadcom iProc based SoCs

config ARCH_BERLIN
	bool "Marvell Berlin SoC Family"
	select DW_APB_ICTL
	select DW_APB_TIMER_OF
	select GPIOLIB
	select PINCTRL
	help
	  This enables support for Marvell Berlin SoC Family

config ARCH_BITMAIN
	bool "Bitmain SoC Platforms"
	help
	  This enables support for the Bitmain SoC Family.

config ARCH_BRCMSTB
	bool "Broadcom Set-Top-Box SoCs"
	select ARCH_HAS_RESET_CONTROLLER
	select BCM7038_L1_IRQ
	select BRCMSTB_L2_IRQ
	select GENERIC_IRQ_CHIP
	select PINCTRL
	help
	  This enables support for Broadcom's ARMv8 Set Top Box SoCs

config ARCH_EXYNOS
	bool "ARMv8 based Samsung Exynos SoC family"
	select COMMON_CLK_SAMSUNG
	select EXYNOS_CHIPID
	select EXYNOS_PM_DOMAINS if PM_GENERIC_DOMAINS
	select EXYNOS_PMU
	select HAVE_S3C_RTC if RTC_CLASS
	select PINCTRL
	select PINCTRL_EXYNOS
	select PM_GENERIC_DOMAINS if PM
	select SOC_SAMSUNG
	help
	  This enables support for ARMv8 based Samsung Exynos SoC family.

config ARCH_SPARX5
	bool "ARMv8 based Microchip Sparx5 SoC family"
	select PINCTRL
	select DW_APB_TIMER_OF
	help
	  This enables support for the Microchip Sparx5 ARMv8-based
	  SoC family of TSN-capable gigabit switches.

	  The SparX-5 Ethernet switch family provides a rich set of
	  switching features such as advanced TCAM-based VLAN and QoS
	  processing enabling delivery of differentiated services, and
	  security through TCAM-based frame processing using versatile
	  content aware processor (VCAP).

config ARCH_K3
	bool "Texas Instruments Inc. K3 multicore SoC architecture"
	select PM_GENERIC_DOMAINS if PM
	select MAILBOX
	select SOC_TI
	select TI_MESSAGE_MANAGER
	select TI_SCI_PROTOCOL
	select TI_SCI_INTR_IRQCHIP
	select TI_SCI_INTA_IRQCHIP
	select TI_K3_SOCINFO
	help
	  This enables support for Texas Instruments' K3 multicore SoC
	  architecture.

config ARCH_LAYERSCAPE
	bool "ARMv8 based Freescale Layerscape SoC family"
	select EDAC_SUPPORT
	help
	  This enables support for the Freescale Layerscape SoC family.

config ARCH_LG1K
	bool "LG Electronics LG1K SoC Family"
	help
	  This enables support for LG Electronics LG1K SoC Family

config ARCH_HISI
	bool "Hisilicon SoC Family"
	select ARM_TIMER_SP804
	select HISILICON_IRQ_MBIGEN if PCI
	select PINCTRL
	help
	  This enables support for Hisilicon ARMv8 SoC family

config ARCH_KEEMBAY
	bool "Keem Bay SoC"
	help
	  This enables support for Intel Movidius SoC code-named Keem Bay.

config ARCH_MEDIATEK
	bool "MediaTek SoC Family"
	select ARM_GIC
	select PINCTRL
	select MTK_TIMER
	help
	  This enables support for MediaTek MT27xx, MT65xx, MT76xx
	  & MT81xx ARMv8 SoCs

config ARCH_MESON
	bool "Amlogic Platforms"
	select PINCTRL
	select PINCTRL_MESON
	select COMMON_CLK_GXBB
	select COMMON_CLK_AXG
	select COMMON_CLK_G12A
	select MESON_IRQ_GPIO
	help
	  This enables support for the arm64 based Amlogic SoCs
	  such as the s905, S905X/D, S912, A113X/D or S905X/D2

config ARCH_MVEBU
	bool "Marvell EBU SoC Family"
	select ARMADA_AP806_SYSCON
	select ARMADA_CP110_SYSCON
	select ARMADA_37XX_CLK
	select GPIOLIB
	select GPIOLIB_IRQCHIP
	select MVEBU_GICP
	select MVEBU_ICU
	select MVEBU_ODMI
	select MVEBU_PIC
	select MVEBU_SEI
	select OF_GPIO
	select PINCTRL
	select PINCTRL_ARMADA_37XX
	select PINCTRL_ARMADA_AP806
	select PINCTRL_ARMADA_CP110
	help
	  This enables support for Marvell EBU familly, including:
	   - Armada 3700 SoC Family
	   - Armada 7K SoC Family
	   - Armada 8K SoC Family

config ARCH_MXC
	bool "ARMv8 based NXP i.MX SoC family"
	select ARM64_ERRATUM_843419
	select ARM64_ERRATUM_845719 if COMPAT
	select IMX_GPCV2
	select IMX_GPCV2_PM_DOMAINS
	select PM
	select PM_GENERIC_DOMAINS
	select SOC_BUS
	select TIMER_IMX_SYS_CTR
	help
	  This enables support for the ARMv8 based SoCs in the
	  NXP i.MX family.

config ARCH_QCOM
	bool "Qualcomm Platforms"
	select GPIOLIB
	select PINCTRL
	help
	  This enables support for the ARMv8 based Qualcomm chipsets.

config ARCH_REALTEK
	bool "Realtek Platforms"
	select RESET_CONTROLLER
	help
	  This enables support for the ARMv8 based Realtek chipsets,
	  like the RTD1295.

config ARCH_RENESAS
	bool "Renesas SoC Platforms"
	select GPIOLIB
	select PINCTRL
	select SOC_BUS
	help
	  This enables support for the ARMv8 based Renesas SoCs.

config ARCH_ROCKCHIP
	bool "Rockchip Platforms"
	select ARCH_HAS_RESET_CONTROLLER
	select GPIOLIB
	select PINCTRL
	select PINCTRL_ROCKCHIP
	select PM
	select ROCKCHIP_TIMER
	help
	  This enables support for the ARMv8 based Rockchip chipsets,
	  like the RK3368.

config ARCH_S32
	bool "NXP S32 SoC Family"
	help
	  This enables support for the NXP S32 family of processors.

config ARCH_SEATTLE
	bool "AMD Seattle SoC Family"
	help
	  This enables support for AMD Seattle SOC Family

config ARCH_STRATIX10
	bool "Altera's Stratix 10 SoCFPGA Family"
	help
	  This enables support for Altera's Stratix 10 SoCFPGA Family.

config ARCH_SYNQUACER
	bool "Socionext SynQuacer SoC Family"
	select IRQ_FASTEOI_HIERARCHY_HANDLERS

config ARCH_TEGRA
	bool "NVIDIA Tegra SoC Family"
	select ARCH_HAS_RESET_CONTROLLER
	select ARM_GIC_PM
	select CLKSRC_MMIO
	select TIMER_OF
	select GENERIC_CLOCKEVENTS
	select GPIOLIB
	select PINCTRL
	select PM
	select PM_GENERIC_DOMAINS
	select RESET_CONTROLLER
	help
	  This enables support for the NVIDIA Tegra SoC family.

config ARCH_SPRD
	bool "Spreadtrum SoC platform"
	help
	  Support for Spreadtrum ARM based SoCs

config ARCH_THUNDER
	bool "Cavium Inc. Thunder SoC Family"
	help
	  This enables support for Cavium's Thunder Family of SoCs.

config ARCH_THUNDER2
	bool "Cavium ThunderX2 Server Processors"
	select GPIOLIB
	help
	  This enables support for Cavium's ThunderX2 CN99XX family of
	  server processors.

config ARCH_UNIPHIER
	bool "Socionext UniPhier SoC Family"
	select ARCH_HAS_RESET_CONTROLLER
	select PINCTRL
	select RESET_CONTROLLER
	help
	  This enables support for Socionext UniPhier SoC family.

config ARCH_VEXPRESS
	bool "ARMv8 software model (Versatile Express)"
	select GPIOLIB
	select PM
	select PM_GENERIC_DOMAINS
	help
	  This enables support for the ARMv8 software model (Versatile
	  Express).

config ARCH_VISCONTI
	bool "Toshiba Visconti SoC Family"
	select PINCTRL
	select PINCTRL_VISCONTI
	help
	  This enables support for Toshiba Visconti SoCs Family.

config ARCH_VULCAN
	def_bool n

config ARCH_XGENE
	bool "AppliedMicro X-Gene SOC Family"
	help
	  This enables support for AppliedMicro X-Gene SOC Family

config ARCH_ZX
	bool "ZTE ZX SoC Family"
	select PINCTRL
	help
	  This enables support for ZTE ZX SoC Family

config ARCH_ZYNQMP
	bool "Xilinx ZynqMP Family"
	help
	  This enables support for Xilinx ZynqMP Family

endmenu
```

## linux-5.10.x/drivers/mtd/nand/Kconfig
```kconfig
# SPDX-License-Identifier: GPL-2.0-only

menu "NAND"

config MTD_NAND_CORE
	tristate

source "drivers/mtd/nand/onenand/Kconfig"
source "drivers/mtd/nand/raw/Kconfig"
source "drivers/mtd/nand/spi/Kconfig"

menu "ECC engine support"

config MTD_NAND_ECC
       bool
       depends on MTD_NAND_CORE

endmenu

menuconfig MTD_RTK_NAND
	tristate "RTK NAND Device Support"

if MTD_RTK_NAND
choice
	prompt "Realtek NAND Flash Controller"
	#depends on MTD_NAND_CORE
	default MTD_SPI_NAND_RTK
	optional

	#config MTD_NAND_RTK
	#	bool "Realtek Parallel NAND Flash Driver"

	config MTD_SPI_NAND_RTK
		bool "Realtek SPI NAND Flash Driver"
	#config MTD_ONFI_NAND_RTK
	#	bool "Realtek ONFI NAND Flash Driver"

endchoice

#config MTD_DUALIF_NAND_RTK
#	depends on MTD_SPI_NAND_RTK || MTD_ONFI_NAND_RTK
#	bool "Support dual SPI/ONFI interface"

choice
	prompt "SPI NAND driver version"
	depends on MTD_SPI_NAND_RTK || MTD_DUALIF_NAND_RTK
	default RTK_SPI_NAND_GEN3
	#config RTK_SPI_NAND_GEN1
	#	bool "SPI NAND driver"
	config RTK_SPI_NAND_GEN3
		bool "SPI NAND driver gen 3"
endchoice

#config MTD_NAND_MULTI_RTK
#	depends on RTK_SPI_NAND_GEN3
#	bool "Support multi-flash"

#choice
#	prompt "ONFI NAND driver version"
#	depends on MTD_ONFI_NAND_RTK || MTD_DUALIF_NAND_RTK
#	config RTK_ONFI_GEN1
#		bool "ONFI NAND driver"
#	config RTK_ONFI_GEN2
#		bool "ONFI NAND driver gen 2"
#endchoice

choice
	prompt "ECC driver version"
	depends on MTD_SPI_NAND_RTK || MTD_ONFI_NAND_RTK
	default RTK_ECC_GEN2
	#config RTK_ECC_GEN1
	#	depends on RTK_SPI_NAND_GEN1 || RTK_ONFI_GEN1
	#	bool "ECC driver"
	config RTK_ECC_GEN2
		bool "ECC driver gen 2"
endchoice


config UBI_MTD_RTK_PATCH
	depends on MTD_NAND_RTK || MTD_SPI_NAND_RTK || MTD_ONFI_NAND_RTK
	  bool "Add UBI patch"
		default y if UBIFS_FS
		help
			"Add some behavior patches for UBI, enable it if use UBI/UBIFS"

config MAX_ALLOWED_ERR_IN_BLANK_PAGE
	depends on MTD_NAND_RTK || MTD_SPI_NAND_RTK || MTD_ONFI_NAND_RTK
 	int "Max allowed bit error in ECC chunk"
	default 4
	help
		"Allow number of bits flipped in a ECC chunk of blank page"

endif

endmenu
```

## linux-5.10.x/drivers/mtd/nand/spi/Kconfig
```kconfig
# SPDX-License-Identifier: GPL-2.0-only
menuconfig MTD_SPI_NAND
	tristate "SPI NAND device Support"
	select MTD_NAND_CORE
	depends on SPI_MASTER
	select SPI_MEM
	help
	  This is the framework for the SPI NAND device drivers.

if MTD_SPI_NAND
	config NAND_HIDE_BAD
	tristate "NAND Flash factory bad block hidden mechanism"
	depends on ARCH_CORTINA && MTD_SPI_NAND
	help
	  This configuration is used for the factory bad block hidden mechanism

	config SPI_NAND_PAGECACHE
    default y
	tristate "Enhance the performance with PAGE_CACHE mechanism."
	depends on ARCH_CORTINA && MTD_SPI_NAND
	help
	  This configuration is used for caching the page that had been read last time.

endif # MTD_SPI_NAND
```

## linux-5.10.x/drivers/net/wireless/realtek/Kconfig
```kconfig
# SPDX-License-Identifier: GPL-2.0-only
config WLAN_VENDOR_REALTEK
	bool "Realtek devices"
	default y
	help
	  If you have a wireless card belonging to this class, say Y.

	  Note that the answer to this question doesn't directly affect the
	  kernel: saying N will just cause the configurator to skip all the
	  questions about these cards. If you say Y, you will be asked for
	  your specific card in the following questions.

if WLAN_VENDOR_REALTEK

source "drivers/net/wireless/realtek/rtl818x/Kconfig"
source "drivers/net/wireless/realtek/rtlwifi/Kconfig"
source "drivers/net/wireless/realtek/rtl8xxxu/Kconfig"
source "drivers/net/wireless/realtek/rtw88/Kconfig"
source "drivers/net/wireless/realtek/rtl8192cd/Kconfig"
source "drivers/net/wireless/realtek/wnic_skb_pool/Kconfig"

config RTK_WFO
	bool "Realtek WiFi Offload support"
	depends on RTLWIFI6
	default n
	select RTK_TAROKO_IPC
	select RTK_WFOAX
	select GMAC2_USABLE
	help
	  Help message of RTK_WFO

config THER_CTRL
	tristate "Realtek thermal control support"
	default n
	depends on RTLWIFI6
	help
	Realtek thermal control support.

source "drivers/net/wireless/realtek/g6_wifi_driver/Kconfig"

endif # WLAN_VENDOR_REALTEK
```

## linux-5.10.x/drivers/net/wireless/realtek/wnic_skb_pool/Kconfig
```kconfig
config WNIC_RECYCLED_SKB
	bool "WNIC recycled skb head and data buffer"
	help
	  This turns on wnic recycle skb allocation.

config WNIC_RECYCLED_SKB_ALLOC_MAX
        default n
        bool "WNIC recycled skb allocation max"
        depends on WNIC_RECYCLED_SKB
        help
          This turns on wnic recycle skb allocation max recording.
          If you do not need such debuging mechanism, say 'N' here.
```
